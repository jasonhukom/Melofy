#include <Wire.h>
#include <Adafruit_GFX.h>
#include <Adafruit_SSD1306.h>

#define  BUTTON_PIN 14
#define BUZZER_PIN 12

#define SCREEN_WIDTH 128
#define SCREEN_HEIGHT 64

Adafruit_SSD1306 display(SCREEN_HEIGHT, SCREEN_WIDTH, &Wire, -1)

int currentAsset = 0;
bool lastButtonState = HIGH;

const unsigned char asset1[] PROGMEM = {
  // 'file (7)', 32x32px
	0x00, 0x01, 0x00, 0x00, 0x00, 0x3f, 0xf8, 0x00, 0x00, 0x7f, 0xe8, 0x00, 0x00, 0xff, 0xf0, 0x00, 
	0x00, 0x79, 0xf8, 0x00, 0x00, 0x7f, 0xd8, 0x00, 0x00, 0x3f, 0x9c, 0x00, 0x00, 0x7f, 0xdc, 0x00, 
	0x00, 0x7f, 0xfc, 0x00, 0x00, 0x2f, 0xfc, 0x00, 0x00, 0x1f, 0xfc, 0x00, 0x00, 0x00, 0x60, 0x00, 
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	0x00, 0x08, 0x00, 0x00, 0x00, 0x08, 0x00, 0x00, 0x00, 0x00, 0x00, 0x00, 0x00, 0x00, 0x00, 0x00
};

const unsigned char asset2[] PROGMEM = {
	// 'keenan-barber-M7GJFakZObA-unsplash (1)', 32x32px
	0x3f, 0xff, 0xff, 0xff, 0xff, 0xff, 0xff, 0xff, 0xff, 0xff, 0xff, 0xff, 0xff, 0xff, 0xff, 0xff, 
	0xff, 0xff, 0xff, 0xff, 0xff, 0xff, 0xff, 0xff, 0xff, 0xff, 0xff, 0xff, 0xff, 0xff, 0xff, 0xff, 
	0xbf, 0xff, 0xff, 0xff, 0xbf, 0xff, 0xfe, 0x7f, 0xff, 0xdf, 0xfc, 0x1f, 0x7f, 0x0f, 0xfc, 0x1f, 
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	0xf0, 0x00, 0x00, 0x00, 0xf0, 0x00, 0x00, 0x00, 0xf0, 0x00, 0x00, 0x00, 0xe0, 0x00, 0x00, 0x00
};

void updateDisplay() {
  display.clearDisplay();
  display.setTextSize();
  display.setTextColor(SSD1306_WHITE);

  if(currentAsset == 0) {
    display.setCursor(20, 0);
    display.println("Asset 1 : Minecraft Avatar");

    display.drawBitmap(48, 20, asset1, 32, 32, SSD1306_WHITE);
  } else {
    display.setCursor(10, 0);
    display.println("Asset 2 : Cute Cat (Eatable)");

    display.drawBitmap(48, 20, asset2, 32, 32, SSD1306_WHITE);
  }

  display.display(); 
};

void setup() {
  // put your setup code here, to run once:
  Serial.begin(115200);
  pinMode(BUTTON_PIN, INPUT_PULLUP);
  pinMode(BUZZER_PIN, OUTPUT);

  if (!display.begin(SSD1306_SWITCHCAPVCC, 0x3C)) {
    for(;;);
  }

  updateDisplay();
}

void loop() {
  bool currentButtonState = digitalRead(BUTTON_PIN);

  if(lastButtonState == HIGH && currentButtonState == LOW) {
    tone(BUZZER_PIN, 1000);
    delay(100);
    noTone(BUZZER_PIN);

    currentAsset = (currentAsset == 0) ? 1 : 0;

    updateDisplay();
    delay(150);
  }
  lastButtonState = currentButtonState;
  delay(10); // this speeds up the simulation
}
